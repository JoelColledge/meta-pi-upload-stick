## conf/layer.conf
```bitbake
# We have a conf and classes directory, add to BBPATH
BBPATH .= ":${LAYERDIR}"

# We have recipes-* directories, add to BBFILES
BBFILES += "${LAYERDIR}/recipes-*/*/*.bb \
            ${LAYERDIR}/recipes-*/*/*.bbappend \
            ${LAYERDIR}/images/*.bb"

BBFILE_COLLECTIONS += "meta-pi-upload-stick"
BBFILE_PATTERN_meta-pi-upload-stick = "^${LAYERDIR}/"
BBFILE_PRIORITY_meta-pi-upload-stick = "16"

LAYERSERIES_COMPAT_meta-pi-upload-stick = "sumo"
```

## example/meta-local-private/conf/layer.conf
```bitbake
# We have a conf and classes directory, add to BBPATH
BBPATH .= ":${LAYERDIR}"

# We have recipes-* directories, add to BBFILES
BBFILES += "${LAYERDIR}/recipes-*/*/*.bb \
            ${LAYERDIR}/recipes-*/*/*.bbappend"

BBFILE_COLLECTIONS += "meta-local-private"
BBFILE_PATTERN_meta-local-private = "^${LAYERDIR}/"
BBFILE_PRIORITY_meta-local-private = "15"

LAYERSERIES_COMPAT_meta-local-private = "sumo"
```
